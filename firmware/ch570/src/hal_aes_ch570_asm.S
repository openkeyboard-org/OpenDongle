/*
 * OpenKeyboard.org OpenDongle
 * Copyright 2026 Eric Molitor (EMulator)
 * CH570 AES-128 forward cipher, hand-written assembly.
 *
 * TWO backends live in this file, selected by DONGLE_AES_CH570_IMPL (see
 * hal_aes_ch570_impl.h for the measurements behind the choice and for ASM_F's
 * hard dependency on CORECFGR bit 3). Both define hal_aes_encrypt_block() and
 * both own their own S-box and round-key storage; hal_aes_ch570.c supplies
 * hal_aes_init() and the matching hal_aes_set_key() for whichever is selected.
 *
 * Neither is reachable when DONGLE_AES_CH570_IMPL is ..._C — that backend is
 * pure C in aes_sw.c and this file then assembles to nothing.
 *
 * DO NOT hand-edit the kernels below. They were generated by five independent
 * agents working to a common brief and each was validated byte-for-byte against
 * a CH572 hardware AES engine over 512 pseudorandom key/plaintext pairs. If one
 * needs changing, change it in bench/aes_spike/asm_{a,f}/ where its test
 * harness, host model and README live, re-run the differential, and re-import.
 *
 * Provenance and full results: bench/aes_spike/ASM-RESULTS.md, DECISION.md.
 */

#include "hal_aes_ch570_impl.h"

#if DONGLE_AES_CH570_IMPL == DONGLE_AES_CH570_IMPL_ASM_A

/* ==========================================================================
 * VARIANT A — rolled row-major SWAR, S-box in SRAM, called S-box helper.
 * 1,669 cycles/block. In a real link of this firmware it adds 840 B of SRAM:
 * 404 B .highcode + 256 B S-box + 176 B schedule = 836 B nominal, plus 4 B of
 * .data alignment padding. (A bench build reports 400 B of code rather than
 * 404 -- different alignment and relaxation. Trust the firmware link.)
 * Zero spills: 16 registers, all caller-saved, no stack frame at all.
 * Build with -Wa,--defsym,AES_A_INLINE=1 to inline the S-box helper instead:
 * 1,509 cycles for +100 B, which spends the margin this variant exists for.
 * ========================================================================== */

/*
 * OpenDongle -- AES-128 forward cipher, variant A: compact ROLLED assembly.
 * CH570 / QingKe V3C, rv32imc_zba_zbb_zbc_zbs_xw, ilp32.
 *
 * The budget-safe candidate.  956 B of SRAM are available in total, the S-box
 * takes 256 and the round-key schedule 176, so everything else here has to live
 * in what is left -- and the point of this variant is to leave slack, not to
 * spend the last byte.
 *
 * COST MODEL THIS WAS WRITTEN AGAINST (measured on CH570, SRAM-resident):
 *
 *   ALU / shift / rori / mul / clmul / Zbb / Zbs   1 cycle, fully forwarded
 *   lw / lbu / sw / sb                             2 cycles
 *   taken branch or jump                           2 cycles
 *   not-taken branch                               1 cycle
 *
 * There is NO load-use interlock on this core: a load followed immediately by
 * its dependent consumer costs exactly the same as a load followed by an
 * independent instruction.  So nothing below wastes an instruction or a
 * register scheduling around the S-box loads -- every `lbu` is followed
 * directly by the instruction that consumes it.  A byte load also costs the
 * same as a word load, so `xw`'s 2-byte `c.lbu` is a pure code-size win at
 * identical speed, which is what makes this variant's size possible at all.
 *
 * SHAPE
 *
 *   State is four 32-bit words, one per ROW of the AES state, held in a0..a3
 *   for the entire cipher.  r[row] byte j is in[4j + row].  In that layout:
 *
 *     - ShiftRows is one `rori` per row, applied to the INPUT of the S-box pass
 *       rather than its output (the S-box is byte-wise, so the two commute);
 *     - MixColumns is a SWAR xtime over whole words -- four GF(2^8) doublings
 *       per instruction group, no table at all;
 *     - AddRoundKey is four word loads from a schedule pre-transposed into the
 *       same row layout by hal_aes_set_key().
 *
 * ROLLED, NOT UNROLLED
 *
 *   Unrolling won 15% for the C cipher when it ran from FLASH, because every
 *   taken back-edge restarted this core's prefetcher.  From SRAM a taken branch
 *   costs 2 cycles and a not-taken one 1, so the entire loop control of this
 *   kernel is worth almost nothing.  MEASURED, like for like (both builds
 *   inlining the S-box pass, so the loop is the only difference):
 *
 *     rolled    504 B   1558 cycles
 *     unrolled 3232 B   1502 cycles     -56 cycles (-3.6%) for +2728 B
 *
 *   Forty-nine bytes per cycle, and 3.8x over the SRAM budget.  AES_A_UNROLL=1
 *   builds it so the claim is measured rather than asserted.
 *
 * REGISTER ALLOCATION -- 16 registers, zero spills, no stack frame at all
 *
 *   a0 a1 a2 a3  state rows r0..r3          (x10..x13: the compressed set, so
 *                                            every state XOR is a 2-byte c.xor
 *                                            and every output store a 2-byte
 *                                            xw c.sb)
 *   a4           sub4 result / general temp / MixColumns w2
 *   a5           sub4 address temp; input pointer in the prologue, output
 *                pointer in the epilogue
 *   a6           output pointer, held across the cipher
 *   a7           MixColumns t = r0^r1^r2^r3
 *   t0           S-box base                 (SRAM)
 *   t1           round-key pointer          (SRAM, walks the schedule)
 *   t2           round counter
 *   t3           0x80808080                 (SWAR xtime carry mask)
 *   t4           0x1b                       (SWAR xtime reduction polynomial)
 *   t5           saved return address       (ra is the link for sub4)
 *   t6           sub4 argument / MixColumns w0
 *   ra           link register / MixColumns w1 (nothing is called from inside
 *                MixColumns, so ra is a free temp there)
 *
 *   Nothing callee-saved is touched, so there is no prologue, no epilogue and
 *   no stack traffic: not one sw/lw relative to sp anywhere in this file.
 *   Grep the listing for "(sp)" -- there are zero hits.
 *
 * BUILD SWITCHES (assembler --defsym, all optional)
 *
 *   AES_A_INLINE=1   inline the four S-box passes instead of calling sub4:
 *                    1798 -> 1558 cycles/block (-13%) for +100 B.  Still fits
 *                    (936 B of 956) but leaves only 20 B of margin against this
 *                    build's 120; offered, not shipped.  See README.md.
 *   AES_A_UNROLL=1   fully unroll the ten rounds (implies inlining).  Does NOT
 *                    fit; built only to measure what unrolling is worth here.
 */

/*
 * Deliberately NO `.align 2` here.  RISC-V with the C extension has IALIGN=16,
 * so a 2-byte-aligned entry is architecturally fine, and asking for 4 makes GAS
 * pad the section tail with a c.nop and the linker round up again -- four bytes
 * for nothing.  Alignment padding was separately measured on this core (Exp C
 * in OPTIMISATION-LOG.md: -falign-functions/loops=32 was both slower and
 * bigger), so there is no fetch reason to buy it back.
 */
	.section .highcode.aes_a, "ax", @progbits

.ifdef AES_A_UNROLL
	AES_A_INLINE = 1
.endif

/* --------------------------------------------------------------- macros -- */

/*
 * One state row of the input transpose:  r = in[k] | in[k+4]<<8 | ...
 * lbu compresses to the 2-byte xw c.lbu (5-bit offset, base and destination in
 * x8..x15), which is why a5 holds the input pointer and a4 the byte.
 */
.macro ROWIN reg, k
	lbu	\reg, \k+0(a5)
	lbu	a4, \k+4(a5)
	slli	a4, a4, 8
	or	\reg, \reg, a4
	lbu	a4, \k+8(a5)
	slli	a4, a4, 16
	or	\reg, \reg, a4
	lbu	a4, \k+12(a5)
	slli	a4, a4, 24
	or	\reg, \reg, a4
.endm

/* One state row of the output transpose.  Destroys \reg; sb -> xw c.sb. */
.macro ROWOUT reg, k
	sb	\reg, \k+0(a5)
	srli	\reg, \reg, 8
	sb	\reg, \k+4(a5)
	srli	\reg, \reg, 8
	sb	\reg, \k+8(a5)
	srli	\reg, \reg, 8
	sb	\reg, \k+12(a5)
.endm

/*
 * Four GF(2^8) doublings at once, in place on a4, temp a5.
 *
 *   m  = x & 0x80808080          the bits that would overflow their byte
 *   y  = (x ^ m) << 1            i.e. (x & 0x7f7f7f7f) << 1 -- reusing m costs
 *                                nothing and avoids a second mask constant
 *   m  = (m >> 7) * 0x1b         0x1b into every byte whose msb was set; the
 *                                multiplicand has isolated bits at 8k so the
 *                                integer multiply cannot carry between bytes
 *   x' = y ^ m
 *
 * Six instructions, 16 bytes, six cycles (mul is single-cycle here), two
 * constant registers.  The `andn` form is the same instruction count and two
 * bytes longer.  clmul was considered and rejected: multiply-by-2 IS a shift,
 * and clmul cannot isolate the per-byte msb, so it saves nothing.
 */
.macro XT4
	and	a5, a4, t3
	xor	a4, a4, a5
	slli	a4, a4, 1
	srli	a5, a5, 7
	mul	a5, a5, t4
	xor	a4, a4, a5
.endm

/*
 * Non-destructive extraction of byte \b of \src into a5.
 *   b=0  andi                       4 B, 1 instr
 *   b=1  slli 16 ; srli 24          6 B, 2 instr
 *   b=2  slli  8 ; srli 24          6 B, 2 instr
 *   b=3  srli 24                    4 B, 1 instr
 * The shift pair beats srli+andi because `andi rd,rs,255` is four bytes and
 * cannot compress, while the second half of a shift pair can.
 */
.macro GETB src, b
.if \b == 0
	andi	a5, \src, 255
.elseif \b == 1
	slli	a5, \src, 16
	srli	a5, a5, 24
.elseif \b == 2
	slli	a5, \src, 8
	srli	a5, a5, 24
.else
	srli	a5, \src, 24
.endif
.endm

/* Destructive extraction of byte \b of \reg into \reg -- two bytes cheaper
 * because the two-operand compressed shift forms apply. */
.macro GETBD reg, b
.if \b == 0
	andi	\reg, \reg, 255
.elseif \b == 1
	slli	\reg, \reg, 16
	srli	\reg, \reg, 24
.elseif \b == 2
	slli	\reg, \reg, 8
	srli	\reg, \reg, 24
.else
	srli	\reg, \reg, 24
.endif
.endm

/*
 * Inlined SubBytes+ShiftRows for row \r, in place on \reg.
 *
 * The ShiftRows rotate is folded in by permuting which source byte feeds which
 * output byte -- output byte j takes source byte (j + r) mod 4 -- so the `rori`
 * disappears entirely.  Every source byte is still extracted exactly once, so
 * the fold is free; only the ORDER changes.
 *
 * (aes_sw.c records this same transformation measuring 37% SLOWER in C.  That
 * was a compiler effect: four rotate-folded expansions of sub4 stopped GCC
 * sharing work between them.  Here the four expansions are written out anyway
 * and the register allocation is fixed by hand, so there is nothing left to
 * lose -- the fold is a strict removal of three instructions per round.)
 */
.macro SUBROW_INLINE reg, r
	GETB	\reg, ((\r + 0) % 4)
	add	a5, a5, t0
	lbu	a4, 0(a5)
	GETB	\reg, ((\r + 1) % 4)
	add	a5, a5, t0
	lbu	a5, 0(a5)
	slli	a5, a5, 8
	or	a4, a4, a5
	GETB	\reg, ((\r + 2) % 4)
	add	a5, a5, t0
	lbu	a5, 0(a5)
	slli	a5, a5, 16
	or	a4, a4, a5
	GETBD	\reg, ((\r + 3) % 4)
	add	\reg, \reg, t0
	lbu	\reg, 0(\reg)
	slli	\reg, \reg, 24
	or	\reg, \reg, a4
.endm

/*
 * Called SubBytes+ShiftRows for row \r.  The rotate writes straight into the
 * argument register, so rows 1..3 pay no separate `mv` -- the rori IS the
 * argument move.
 */
.macro SUBROW_CALL reg, r
.if \r == 0
	mv	t6, \reg
.else
	rori	t6, \reg, 8*\r
.endif
	jal	ra, aes_a_sub4
	mv	\reg, a4
.endm

.macro SUBROW reg, r
.ifdef AES_A_INLINE
	SUBROW_INLINE	\reg, \r
.else
	SUBROW_CALL	\reg, \r
.endif
.endm

/*
 * MixColumns.
 *
 *   n_i = r_i ^ t ^ xtime(r_i ^ r_{i+1}),   t = r0^r1^r2^r3
 *
 * Fold t into each combiner, w_i = t ^ xtime(r_i ^ r_{i+1}).  Then
 *
 *   w0 ^ w1 ^ w2 = t ^ xtime(r0^r3) = w3
 *
 * because xtime is F2-linear and t^t^t = t.  That derives the fourth combiner
 * in two XORs instead of a whole six-instruction xtime: four instructions saved
 * per round, 36 per block, for no extra register.
 */
.macro MIXCOLUMNS
	xor	a7, a0, a1
	xor	a7, a7, a2
	xor	a7, a7, a3		/* t                                 */
	xor	a4, a0, a1
	XT4
	xor	t6, a4, a7		/* w0                                */
	xor	a4, a1, a2
	XT4
	xor	ra, a4, a7		/* w1                                */
	xor	a4, a2, a3
	XT4
	xor	a4, a4, a7		/* w2                                */
	xor	a0, a0, t6
	xor	a1, a1, ra
	xor	a2, a2, a4
	xor	a4, a4, t6
	xor	a4, a4, ra		/* w3 = w0 ^ w1 ^ w2                 */
	xor	a3, a3, a4
.endm

/* --------------------------------------- hal_aes_status_t hal_aes_encrypt_block
 *   a0 = const uint8_t in[16]
 *   a1 =       uint8_t out[16]
 * out may alias or overlap in: all 16 input bytes are read in the prologue,
 * before any output byte is written in the epilogue.
 */
	.globl	hal_aes_encrypt_block
	.type	hal_aes_encrypt_block, @function
hal_aes_encrypt_block:
	mv	t5, ra			/* ra becomes the link for sub4      */
	mv	a6, a1			/* out                               */
	mv	a5, a0			/* in                                */
	la	t0, aes_a_sbox
	li	t3, 0x80808080
	li	t4, 0x1b

	/* transpose the input into row words */
	ROWIN	a0, 0
	ROWIN	a1, 1
	ROWIN	a2, 2
	ROWIN	a3, 3

.ifdef AES_A_UNROLL
	/* ---------------- fully unrolled: measurement build only --------- */
	la	t1, aes_a_rk
	lw	a4, 0(t1)
	xor	a0, a0, a4
	lw	a4, 4(t1)
	xor	a1, a1, a4
	lw	a4, 8(t1)
	xor	a2, a2, a4
	lw	a4, 12(t1)
	xor	a3, a3, a4
	.set	rnd, 1
	.rept	9
	SUBROW	a0, 0
	SUBROW	a1, 1
	SUBROW	a2, 2
	SUBROW	a3, 3
	MIXCOLUMNS
	lw	a4, 16*rnd+0(t1)
	xor	a0, a0, a4
	lw	a4, 16*rnd+4(t1)
	xor	a1, a1, a4
	lw	a4, 16*rnd+8(t1)
	xor	a2, a2, a4
	lw	a4, 16*rnd+12(t1)
	xor	a3, a3, a4
	.set	rnd, rnd+1
	.endr
	SUBROW	a0, 0
	SUBROW	a1, 1
	SUBROW	a2, 2
	SUBROW	a3, 3
	lw	a4, 160(t1)
	xor	a0, a0, a4
	lw	a4, 164(t1)
	xor	a1, a1, a4
	lw	a4, 168(t1)
	xor	a2, a2, a4
	lw	a4, 172(t1)
	xor	a3, a3, a4
.else
	/* ---------------- rolled: the shipping shape --------------------- */
	/*
	 * Enter at the AddRoundKey block so round key 0 costs no separate
	 * code: t1 starts one round key low and the block's own `addi` walks
	 * it onto rk[0].  Eleven AddRoundKeys, ten rounds, one copy of each.
	 *
	 * The counter is 10, not 11: the entry jump already performs one
	 * AddRoundKey, and t2 is decremented at the TOP of each pass, so ten
	 * passes leaves t2 == 0 exactly as the last round's AddRoundKey runs.
	 */
	la	t1, aes_a_rk-16
	li	t2, 10
	j	2f
1:	addi	t2, t2, -1
	SUBROW	a0, 0
	SUBROW	a1, 1
	SUBROW	a2, 2
	SUBROW	a3, 3
	beqz	t2, 2f			/* round 10 has no MixColumns        */
	MIXCOLUMNS
2:	addi	t1, t1, 16
	lw	a4, 0(t1)
	xor	a0, a0, a4
	lw	a4, 4(t1)
	xor	a1, a1, a4
	lw	a4, 8(t1)
	xor	a2, a2, a4
	lw	a4, 12(t1)
	xor	a3, a3, a4
	bnez	t2, 1b
.endif

	/* transpose the rows back out */
	mv	a5, a6
	ROWOUT	a0, 0
	ROWOUT	a1, 1
	ROWOUT	a2, 2
	ROWOUT	a3, 3
	li	a0, 0			/* HAL_AES_OK -- see hal_aes.h            */
	jr	t5
	.size	hal_aes_encrypt_block, . - hal_aes_encrypt_block

.ifndef AES_A_INLINE
/* ------------------------------------------------------------------ sub4 --
 * t6 -> a4 : four parallel S-box lookups, a4 = S[b3]<<24 | ... | S[b0].
 * Clobbers a4, a5.  Reads t0 (S-box base).  Does not touch ra.
 *
 * 20 instructions, 50 bytes, 24 cycles.  Called forty times per block, so the
 * jal/ret pair and the two argument moves cost 6 cycles per call, 240 per
 * block -- that is exactly the price of fitting the budget, and it is measured
 * against the inlined build in README.md.
 */
	.type	aes_a_sub4, @function
aes_a_sub4:
	srli	a5, t6, 24
	add	a5, a5, t0
	lbu	a4, 0(a5)
	slli	a5, t6, 8
	srli	a5, a5, 24
	add	a5, a5, t0
	lbu	a5, 0(a5)
	slli	a4, a4, 8
	or	a4, a4, a5
	slli	a5, t6, 16
	srli	a5, a5, 24
	add	a5, a5, t0
	lbu	a5, 0(a5)
	slli	a4, a4, 8
	or	a4, a4, a5
	andi	a5, t6, 255
	add	a5, a5, t0
	lbu	a5, 0(a5)
	slli	a4, a4, 8
	or	a4, a4, a5
	ret
	.size	aes_a_sub4, . - aes_a_sub4
.endif

	.globl	aes_a_code_end
aes_a_code_end:

/* --------------------------------------------------------------- SRAM data
 * Both of these must be in SRAM and both count against the 956 B budget.
 * .data gets a flash LMA and is copied at boot by the reset handler, exactly
 * as aes_sw.c's S-box does -- and for the same reason: a flash data read costs
 * ~9.4 cycles against ~0.75 from RAM, and there are 160 of them per block.
 */
	.section .data.aes_a, "aw", @progbits
	.globl	aes_a_sbox
	.align	2
	.type	aes_a_sbox, @object
aes_a_sbox:
	.byte 0x63,0x7c,0x77,0x7b,0xf2,0x6b,0x6f,0xc5,0x30,0x01,0x67,0x2b,0xfe,0xd7,0xab,0x76
	.byte 0xca,0x82,0xc9,0x7d,0xfa,0x59,0x47,0xf0,0xad,0xd4,0xa2,0xaf,0x9c,0xa4,0x72,0xc0
	.byte 0xb7,0xfd,0x93,0x26,0x36,0x3f,0xf7,0xcc,0x34,0xa5,0xe5,0xf1,0x71,0xd8,0x31,0x15
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	.byte 0x8c,0xa1,0x89,0x0d,0xbf,0xe6,0x42,0x68,0x41,0x99,0x2d,0x0f,0xb0,0x54,0xbb,0x16
	.size	aes_a_sbox, . - aes_a_sbox

	.section .bss.aes_a, "aw", @nobits
	.globl	aes_a_rk
	.align	2
	.type	aes_a_rk, @object
aes_a_rk:
	.space	176			/* 11 round keys x 4 row words       */
	.size	aes_a_rk, . - aes_a_rk

#elif DONGLE_AES_CH570_IMPL == DONGLE_AES_CH570_IMPL_ASM_F

/* ==========================================================================
 * VARIANT F — flash-resident, shaped to the 128-byte ROM loop buffer.
 * 3,960-3,992 cycles/block (the spread is code-layout, not behaviour),
 * measured by firmware/validation on V3C silicon at production CORECFGR 0x2D;
 * fold
 * b106130c on the 512-block differential. (Bench builds of the same kernel
 * measured 3,796/3,797 -- link alignment and harness overhead, not a
 * behaviour difference.) ZERO bytes of code in SRAM, 432 B of data (256 B
 * S-box + 176 B schedule). Leaves the radio .highcode entirely untouched.
 *
 * REQUIRES CORECFGR bit 3 (ROM_LOOP_ACC). With it clear this is still
 * bit-exact but degrades to ~42,000-68,000 cycles/block, which is why the
 * selector #errors rather than build it that way. Production boots 0x2D
 * (bit 3 SET) — see hal_aes_ch570_impl.h and ch570_corecfgr.h.
 *
 * Its 108-byte inner loop body sits inside the measured <=112 B unconditional
 * band. Do not grow it: at 120 B it needs .balign 128 to work at all, and at
 * 128 B it stops being accelerated entirely.
 * ========================================================================== */

/*
 * OpenKeyboard.org OpenDongle
 * AES-128 forward cipher, variant F: FLASH-RESIDENT, LOOP-BUFFER-SIZED.
 *
 * Every other variant of this exercise fights over 956 bytes of SRAM by
 * relocating code into .highcode.  This one puts ZERO code in SRAM.  It runs
 * from flash and instead makes the whole cipher fit the QingKe V3 ROM_LOOP_ACC
 * loop buffer (CORECFGR bit 3), which on this silicon runs a flash-resident
 * loop body of <=112 bytes at ~1.10 cycles/instruction -- inside 7% of SRAM
 * speed -- at any alignment, and <=120 bytes if the loop head is 128-byte
 * aligned.
 *
 * The consequence is that the shape of the cipher is dictated by ONE number:
 * the byte size of the loop body.  So:
 *
 *   - There is exactly ONE loop over the entire cipher.  Not a loop per round
 *     with a round-boundary tail; not a nest.  One label, one backward branch,
 *     40 iterations = 10 rounds x 4 columns, and 87.6% of all dynamic
 *     instructions execute inside it (98.7% inside some <=112-byte loop, once
 *     the 20-byte AddRoundKey prologue and the 12-byte output loop are
 *     counted).  Only 26 instructions per block -- 1.3% -- are straight-line
 *     flash that the buffer can never cover.
 *   - Everything that would normally be round-boundary code -- which buffer is
 *     the source, which is the destination, which round key, and whether this
 *     round skips MixColumns -- is derived branchlessly from the loop counter
 *     inside the body.  A round boundary costs zero instructions.
 *   - ShiftRows costs zero instructions.  The state is held in memory twice
 *     over (a 16-byte state followed by a copy of itself), so the shifted
 *     source index (4c + 5r) mod 16, which never exceeds 27, is reachable as
 *     four CONSTANT offsets 0/5/10/15 from one base register.  That turns the
 *     gather into four 2-byte `xw` c.lbu with no index arithmetic at all.
 *
 * Body size: 108 bytes / 44 instructions.  See README.md.
 *
 * SRAM cost: 256 B S-box + 176 B round-key schedule = 432 B of .data/.bss,
 * plus a 144-byte stack frame.  No .highcode.  Nothing on the radio hot path
 * moves.
 *
 * ISA: rv32imc_zba_zbb_zbc_zbs_xw.  Uses sh1add (Zba), rori and orc.b (Zbb),
 * and the xw compressed byte load/store forms.  No clmul, no Zbk.
 *
 * CORRECTNESS IS INDEPENDENT OF THE LOOP BUFFER.  With CORECFGR bit 3 off
 * (production's 0x25) this code produces identical ciphertext, just ~30x
 * slower.  The bit is a performance dependency, not a functional one.
 */

/*
 * ---------------------------------------------------------------- registers
 *
 *   s0  x8   ps, then pd (pd = ps ^ 32)     xw c.lbu / c.sb / c.sw base
 *   s1  x9   round-key pointer              c.lw base
 *   a0  x10  gathered byte 0 -> column word w
 *   a1  x11  gathered byte 1 -> u -> round-key word
 *   a2  x12  gathered byte 2 -> T
 *   a3  x13  gathered byte 3 -> h
 *   a4  x14  0x1b1b1b1b                     c.and operand, must be x8-x15
 *   a5  x15  MixColumns mask (-1 or 0)      c.and operand, must be x8-x15
 *   t0  x5   S-box base
 *   t1  x6   B, the 64-byte-aligned state buffer pair
 *   t2  x7   caller's `out`
 *   t3  x28  d, the loop counter: -144, -140, ... , +12
 *   t4  x29  scratch
 *   t6  x31  0x80808080
 *
 * Only s0/s1 are callee-saved, so the frame is two words plus the buffer.
 *
 * ------------------------------------------------------------ the counter d
 *
 * d runs -144, -140, ... , +12, step 4, 40 iterations, and encodes the entire
 * round structure:
 *
 *   d & 12         = 4c, the column offset                     (0,4,8,12)
 *   (d & 16) << 1  = source buffer select                      (0 or 32)
 *                    d advances 16 per round, so bit 4 flips every round
 *   d >> 31        = -1 for rounds 1..9, 0 for round 10        (MixColumns on)
 *                    d < 0 for the first 36 iterations = 9 rounds
 *
 * The final state always lands in the buffer at B+32, because the last
 * iteration has d = 12 -> select 0 -> source B+0 -> dest B+32.
 *
 * ------------------------------------------------------------- state layout
 *
 * 64 bytes at B, 64-byte aligned:
 *
 *   B+ 0..15  state A     B+16..31  copy of state A
 *   B+32..47  state B     B+48..63  copy of state B
 *
 * B must be 64-byte aligned so that `xori s0, s0, 32` swaps A<->B exactly:
 * ps = B + sel + 4c with sel in {0,32} and 4c <= 12, so bit 5 is the buffer
 * select and nothing below it can carry into it.
 */

	.option	arch, rv32imc_zba_zbb_zbc_zbs_xw

/* ================================================== hal_aes_encrypt_block */
	.section .text.hal_aes_encrypt_block,"ax",@progbits
	.globl	hal_aes_encrypt_block
	.type	hal_aes_encrypt_block,@function
	.balign	4
hal_aes_encrypt_block:
	addi	sp, sp, -144
	sw	s0, 0(sp)
	sw	s1, 4(sp)

	mv	t2, a1			/* stash `out`; a1 is a loop temp    */
	addi	t1, sp, 71
	andi	t1, t1, -64		/* B = 64-byte-aligned buffer pair    */

	lla	t0, aes_f_sbox
	lla	s1, aes_f_rk

	/*
	 * Prologue loop: initial AddRoundKey, 16 iterations, 20-byte body.
	 * Writes the state AND its duplicate.  Falls out with s1 = rk + 16,
	 * which is exactly the round-1 key the main loop wants.
	 *
	 * "read all 16 input bytes before writing any output byte" is honoured
	 * by construction: `in` is fully consumed here, `out` only at the end.
	 */
	addi	s0, t1, 32		/* round 0 writes state B             */
	addi	a3, a0, 16
.Lark0:
	lbu	a1, 0(a0)
	lbu	a2, 0(s1)
	addi	a0, a0, 1
	addi	s1, s1, 1
	xor	a1, a1, a2
	sb	a1, 0(s0)
	sb	a1, 16(s0)
	addi	s0, s0, 1
	bne	a0, a3, .Lark0

	li	t6, 0x80808080
	li	a4, 0x1b1b1b1b
	li	t3, -144
	li	t5, 12			/* loop bound: run through d = +12       */

	/*
	 * Jump over the alignment padding: the padding must not be executed.
	 * The body is 108 bytes, which the measured table says is accelerated
	 * at ANY alignment (<=112 B), so this .balign is margin, not a
	 * requirement -- it buys the best measured cycles/instruction and room
	 * to grow to 120 B without a re-measurement.
	 */
	j	.Lround
	.balign	128
.Lround:
	/* ---- addressing + MixColumns mask, all from d ------------- 18 B -- */
	andi	t4, t3, 16		/* 4  buffer select, 0 or 16          */
	sh1add	s0, t4, t1		/* 4  ps = B + 0 or 32                */
	andi	t4, t3, 12		/* 4  column offset 4c                */
	add	s0, s0, t4		/* 2  ps = B + sel + 4c               */
	srai	a5, t3, 31		/* 4  -1 for rounds 1..9, else 0      */

	/* ---- SubBytes o ShiftRows: four lookups, no load-use stall  36 B -- */
	lbu	a0, 0(s0)		/* 2  s[0][c]                         */
	lbu	a1, 5(s0)		/* 2  s[1][c+1]                       */
	lbu	a2, 10(s0)		/* 2  s[2][c+2]                       */
	lbu	a3, 15(s0)		/* 2  s[3][c+3]                       */
	add	a0, a0, t0		/* 2                                  */
	add	a1, a1, t0		/* 2                                  */
	add	a2, a2, t0		/* 2                                  */
	add	a3, a3, t0		/* 2                                  */
	lbu	a0, 0(a0)		/* 2                                  */
	lbu	a1, 0(a1)		/* 2                                  */
	lbu	a2, 0(a2)		/* 2                                  */
	lbu	a3, 0(a3)		/* 2                                  */
	slli	a1, a1, 8		/* 2                                  */
	slli	a2, a2, 16		/* 2                                  */
	slli	a3, a3, 24		/* 2                                  */
	or	a0, a0, a1		/* 2                                  */
	or	a2, a2, a3		/* 2                                  */
	or	a0, a0, a2		/* 2  w = column word                 */

	/* ---- MixColumns: w ^ T ^ xtime(u),  u = w ^ ror(w,8) ------ 34 B -- */
	rori	a1, a0, 8		/* 4                                  */
	xor	a1, a1, a0		/* 2  u                               */
	rori	a2, a1, 16		/* 4                                  */
	xor	a2, a2, a1		/* 2  T = a0^a1^a2^a3 in every byte   */
	and	a3, a1, t6		/* 4  h = u & 0x80808080              */
	xor	a1, a1, a3		/* 2  u &= 0x7f7f7f7f                 */
	slli	a1, a1, 1		/* 2  no carry between bytes          */
	orc.b	a3, a3			/* 4  0xff per byte where bit 7 set   */
	and	a3, a3, a4		/* 2  -> 0x1b there                   */
	xor	a1, a1, a3		/* 2  u = xtime(u)                    */
	xor	a1, a1, a2		/* 2  ^ T                             */
	and	a1, a1, a5		/* 2  round 10: drop the whole delta  */
	xor	a0, a0, a1		/* 2                                  */

	/* ---- AddRoundKey ------------------------------------------- 6 B -- */
	lw	a1, 0(s1)		/* 2                                  */
	addi	s1, s1, 4		/* 2                                  */
	xor	a0, a0, a1		/* 2                                  */

	/* ---- store the column and its duplicate into the other buf   8 B -- */
	xori	s0, s0, 32		/* 4  pd = ps ^ 32                    */
	sw	a0, 0(s0)		/* 2                                  */
	sw	a0, 16(s0)		/* 2                                  */

	/* ---- loop -------------------------------------------------- 6 B -- */
	addi	t3, t3, 4		/* 2                                  */
	bge	t5, t3, .Lround		/* 4  t5 = 12; 40 iterations          */
.Lround_end:

	/* Epilogue loop: the result is always in state B. 12-byte body. */
	addi	s0, t1, 32
	addi	a3, s0, 16
	mv	a2, t2
.Lout:
	lbu	a0, 0(s0)
	sb	a0, 0(a2)
	addi	s0, s0, 1
	addi	a2, a2, 1
	bne	s0, a3, .Lout

	lw	s0, 0(sp)
	lw	s1, 4(sp)
	addi	sp, sp, 144
	li	a0, 0			/* HAL_AES_OK -- see hal_aes.h */
	ret
	.size	hal_aes_encrypt_block, .-hal_aes_encrypt_block

/* ==================================================================== data */
/*
 * The S-box is the ONLY table, and it is in SRAM because a flash data read on
 * this part costs ~9 cycles more than an SRAM read; 160 lookups per block from
 * flash would add ~1,400 cycles and sink the variant outright.  256 bytes is a
 * quarter of what the .highcode variants spend.
 */
	.section .data.aes_f_sbox,"aw",@progbits
	.globl	aes_f_sbox
	.balign	4
	.type	aes_f_sbox,@object
aes_f_sbox:
	.byte 0x63,0x7c,0x77,0x7b,0xf2,0x6b,0x6f,0xc5
	.byte 0x30,0x01,0x67,0x2b,0xfe,0xd7,0xab,0x76
	.byte 0xca,0x82,0xc9,0x7d,0xfa,0x59,0x47,0xf0
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	.byte 0x41,0x99,0x2d,0x0f,0xb0,0x54,0xbb,0x16
	.size	aes_f_sbox, .-aes_f_sbox

	.section .bss.aes_f_rk,"aw",@nobits
	.globl	aes_f_rk
	.balign	4
	.type	aes_f_rk,@object
aes_f_rk:
	.zero	176
	.size	aes_f_rk, .-aes_f_rk

#endif /* DONGLE_AES_CH570_IMPL selects an assembly backend */
